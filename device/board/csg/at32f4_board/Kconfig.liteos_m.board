## device/board/csg/at32f4_board/Kconfig.liteos_m.board
```kconfig
# Copyright (C) 2022 HiHope Open Source Organization .
# Licensed under the Apache License, Version 2.0 (the "License");
# you may not use this file except in compliance with the License.
# You may obtain a copy of the License at
#
# http://www.apache.org/licenses/LICENSE-2.0
#
# Unless required by applicable law or agreed to in writing, software
# distributed under the License is distributed on an "AS IS" BASIS,
# WITHOUT WARRANTIES OR CONDITIONS OF ANY KIND, either express or implied.
# See the License for the specific language governing permissions and
# limitations under the License.

menuconfig BOARD_AT32F4_BOARD
    bool "select board at32f4"
    depends on SOC_AT32F403

orsource "liteos_m/hdf_config/Kconfig.liteos_m.board"
```

## device/board/csg/hc32f4_board/Kconfig.liteos_m.defconfig.board
```kconfig
# Copyright (C) 2022 HiHope Open Source Organization .
# Licensed under the Apache License, Version 2.0 (the "License");
# you may not use this file except in compliance with the License.
# You may obtain a copy of the License at
#
# http://www.apache.org/licenses/LICENSE-2.0
#
# Unless required by applicable law or agreed to in writing, software
# distributed under the License is distributed on an "AS IS" BASIS,
# WITHOUT WARRANTIES OR CONDITIONS OF ANY KIND, either express or implied.
# See the License for the specific language governing permissions and
# limitations under the License.

if BOARD_HC32F4_BOARD
config BOARD
    string
    default "hc32f4_board"
endif #BOARD_HDSC_BOARD
```

## device/soc/hdsc/hc32f4xx/Kconfig.liteos_m.series
```kconfig
# Copyright (C) 2022 HiHope Open Source Organization .
# Licensed under the Apache License, Version 2.0 (the "License");
# you may not use this file except in compliance with the License.
# You may obtain a copy of the License at
#
# http://www.apache.org/licenses/LICENSE-2.0
#
# Unless required by applicable law or agreed to in writing, software
# distributed under the License is distributed on an "AS IS" BASIS,
# WITHOUT WARRANTIES OR CONDITIONS OF ANY KIND, either express or implied.
# See the License for the specific language governing permissions and
# limitations under the License.

config SOC_SERIES_HC32F4x
    bool "hdsc hc32f4x Series"
    select ARM
    select SOC_COMPANY_HDSC
    select CPU_CORTEX_M4
    help
        Enable support for hdsc hc32f4x series
```
